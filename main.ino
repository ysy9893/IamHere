/* ------------------LED RING REQUISITE----------------- */
#include <Adafruit_NeoPixel.h>
#ifdef __AVR__
#include <avr/power.h> // Required for 16 MHz Adafruit Trinket
#endif

#define LED_PIN 26
#define LED_COUNT 24

Adafruit_NeoPixel strip(LED_COUNT, LED_PIN, NEO_GRB + NEO_KHZ800);

/* -----------------SERVO MOTOR REQUISITE----------------- */
#include <ESP32_Servo.h>

static const int servoPin = 27;

Servo servo1;
int sc[]={90, 115,80};// servo commands are in order 

        
String scText[]={"Stop","CCW","CW"};// define texts for 3 action
int statusText;
int CWBS, CCWBS, SBS;
      //CW button status (CWBS)
      //CCW button status (CCWBS) 
      //stop button status (SBS)



/* ----------------OLED Display---------------- */

#include <Adafruit_GrayOLED.h>
#include <Adafruit_SPITFT.h>
#include <Adafruit_SPITFT_Macros.h>
#include <gfxfont.h>
#include <Adafruit_GFX.h>
#include <Adafruit_SSD1351.h>
#include <SPI.h>

#define SCREEN_WIDTH  128
#define SCREEN_HEIGHT 128 // Change this to 96 for 1.27" OLED.

#define SCLK_PIN 18
#define MOSI_PIN 23
#define DC_PIN   16
#define CS_PIN   5
#define RST_PIN  17

#define  BLACK           0x0000
#define BLUE            0x001F
#define RED             0xF800
#define GREEN           0x07E0
#define CYAN            0x07FF
#define MAGENTA         0xF81F
#define YELLOW          0xFFE0  
#define WHITE           0xFFFF

Adafruit_SSD1351 tft = Adafruit_SSD1351(SCREEN_WIDTH, SCREEN_HEIGHT, CS_PIN, DC_PIN, MOSI_PIN, SCLK_PIN, RST_PIN);  

const unsigned char bitmap_chat [] PROGMEM = {
	// 'chat, 128x128px
	0x00, 0x00, 0x00, 0x00, 0x00, 0x00, 0x00, 0x00, 0x00, 0x00, 0x00, 0x00, 0x00, 0x00, 0x00, 0x00, 
	0x00, 0x00, 0x00, 0x00, 0x00, 0x00, 0x00, 0x00, 0x00, 0x00, 0x00, 0x00, 0x00, 0x00, 0x00, 0x00, 
	0x00, 0x00, 0x00, 0x00, 0x00, 0x00, 0x00, 0x00, 0x00, 0x00, 0x00, 0x00, 0x00, 0x00, 0x00, 0x00, 
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	0x00, 0x00, 0x00, 0x00, 0x00, 0x00, 0x00, 0x00, 0x00, 0x00, 0x00, 0x00, 0x00, 0x00, 0x00, 0x00
};

const unsigned char bitmap_question [] PROGMEM = {
	// 'Question2, 128x128px
	0x00, 0x00, 0x00, 0x00, 0x00, 0x00, 0x00, 0x00, 0x00, 0x00, 0x00, 0x00, 0x00, 0x00, 0x00, 0x00, 
	0x00, 0x00, 0x00, 0x00, 0x00, 0x00, 0x00, 0x00, 0x00, 0x00, 0x00, 0x00, 0x00, 0x00, 0x00, 0x00, 
	0x00, 0x1f, 0xff, 0xff, 0xff, 0xff, 0xff, 0xf0, 0x00, 0x00, 0x00, 0x00, 0x00, 0x00, 0x00, 0x00, 
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	0x00, 0x00, 0x00, 0x00, 0x00, 0x00, 0x00, 0x00, 0x00, 0x00, 0x00, 0x00, 0x00, 0x00, 0x00, 0x00
};

const unsigned char bitmap_sound [] PROGMEM = {
	// 'Sound, 128x128px
	0x00, 0x00, 0x00, 0x00, 0x00, 0x00, 0x00, 0x00, 0x00, 0x00, 0x00, 0x00, 0x00, 0x00, 0x00, 0x00, 
	0x00, 0x00, 0x00, 0x00, 0x00, 0x00, 0x00, 0x00, 0x00, 0x00, 0x00, 0x00, 0x00, 0x00, 0x00, 0x00, 
	0x00, 0x00, 0x00, 0x00, 0x00, 0x00, 0x00, 0x00, 0x00, 0x00, 0x00, 0x00, 0x00, 0x00, 0x00, 0x00, 
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	0x00, 0x00, 0x00, 0x00, 0x00, 0x00, 0x00, 0x00, 0x00, 0x00, 0x00, 0x00, 0x00, 0x00, 0x00, 0x00
};

void setup() {
#if defined(__AVR_ATtiny85__) && (F_CPU == 16000000)
  clock_prescale_set(clock_div_1);
#endif

  Serial.begin(9600);

  /* LED RING SETUP*/
  strip.begin();           // INITIALIZE NeoPixel strip object (REQUIRED)
  strip.show();            // Turn OFF all pixels ASAP
  strip.setBrightness(255); // Set BRIGHTNESS to about 1/5 (max = 255)
  colorWipe(strip.Color(0,   0,   0), 10);

  /* SERVO MOTOR SETUP */
  servo1.attach(servoPin);
  statusText = 0;

  /* OLED SETUP */
  tft.begin();
  tft.fillScreen(BLACK);
}

int input;
void loop() {
  // Fill along the length of the strip in various colors...
  if(Serial.available())
  {
    input = Serial.parseInt();

    //Sound Issue 
    if(input == 1)
    {
      tft.drawBitmap(0, 0, bitmap_sound, 128, 128, RED);

      colorWipe(strip.Color(255,   0,   0), 10);//red
      delay(10);
      Serial.println("Red Light");

      command(1);
      delay(1000);
      command(0);

      

    }
    //Question 
    else if (input == 2)
    {
      tft.drawBitmap(0, 0, bitmap_question, 128, 128, GREEN);

      colorWipe(strip.Color(  0, 255,   0), 10);//green
      delay(10);
      Serial.println("Green Light");

      command(1);
      delay(1000);
      command(0);

    }
    //Chat 
    else if (input == 3)
    {
      tft.drawBitmap(0, 0, bitmap_chat, 128, 128, BLUE);

      colorWipe(strip.Color(  0, 0, 255), 10);//yellow
      delay(10);
      Serial.println("Blue Light");

      command(1);
      delay(1000);
      command(0);

    }
    delay(10000);
    command(2);
    delay(1000);
    command(0);
    tft.fillScreen(BLACK);
    colorWipe(strip.Color(0,   0,   0), 10);
  }

}

/*-------------------------- Function Statement -----------------------*/

/* LED RING FUNCTIONS */
void colorWipe(uint32_t color, int wait) {
  for(int i=0; i<strip.numPixels(); i++) { // For each pixel in strip...
    strip.setPixelColor(i, color);         //  Set pixel's color (in RAM)
    strip.show();                          //  Update strip to match
    delay(wait);                           //  Pause for a moment
  }
}

/* SERVO MOTOR FUNCTIONS */
void command(int n){
  statusText = n; 
  servo1.write(sc[n]);
  Serial.println(n);
}

